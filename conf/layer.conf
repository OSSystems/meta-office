## conf/layer.conf
```bitbake
# We have a conf and classes directory, append to BBPATH
BBPATH .= ":${LAYERDIR}"

BBFILES += "${LAYERDIR}/recipes-*/*/*.bb ${LAYERDIR}/recipes-*/*/*.bbappend"

BBFILE_COLLECTIONS += "office-layer"
BBFILE_PATTERN_office-layer := "^${LAYERDIR}/"
BBFILE_PRIORITY_office-layer = "7"
```
